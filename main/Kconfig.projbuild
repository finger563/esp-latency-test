## main/Kconfig.projbuild
```kconfig
menu "Latency Test Configuration"
    config DEBUG_PLOT_ALL
        bool "Plot all data"
        default n
        help
            If enabled, runs a timer which plots raw adc value every 5 ms.

    config FILTER_ADC
        bool "Filter ADC values"
        default y
        help
            If enabled, filters the ADC values using a simple lowpass filter.

    config FILTER_ALPHA
        int "Filter alpha (*1000)"
        default 1
        range 1 1000
        depends on FILTER_ADC
        help
            The time constant for the lowpass filter. The value will be divided
            by 1000 to get the actual alpha value.

    config TRIGGER_PERIOD_MS
        int "Trigger period (ms)"
        default 300
        range 100 10000
        depends on DEBUG_PLOT_ALL
        help
            The period in milliseconds at which the latency test is triggered.
            Each period will trigger one button press and release.

    config BUTTON_HOLD_TIME_MS
        int "Button hold time (ms)"
        default 100
        range 10 1000
        help
            The time in milliseconds for which the button is held down.

    config MAX_BUTTON_DELAY_MS
        int "Maximum button delay (ms)"
        default 100
        range 0 1000
        help
            The maximum delay / shift in milliseconds between when the button is
            released and when the next button press is triggered.

    config UPPER_THRESHOLD
        int "Threshold value (mV) for registering a screen on event"
        default 80
        help
            The threshold value for registering a screen on event. The value is
            in units of millivolts.

    config LOWER_THRESHOLD
        int "Threshold value (mV) for registering a screen off event"
        default 30
        help
            The threshold value for registering a screen off event. The value is
            in units of millivolts.

    config BUTTON_PRESS_LEVEL
        int "Level which indicates a button press"
        default 0
        range 0 1
        help
            The level which indicates a button press.

    config BUTTON_GPIO
        int "Button GPIO"
        default 17 if IDF_TARGET_ESP32S3
        default 25 if IDF_TARGET_ESP32
        help
            The GPIO pin number for the button. Default maps to A1 on QtPy
            ESP32S3 (GPIO17) and QtPy ESP32 Pico (GPIO25).

    config EXTRA_GND_GPIO
        int "Extra GND GPIO"
        default 9 if IDF_TARGET_ESP32S3
        default 27 if IDF_TARGET_ESP32
        help
            The GPIO pin number for the extra GND connection. Will be set to
            always output low. Default maps to A2 on QtPy ESP32S3 (GPIO9) and
            QtPy ESP32 Pico (GPIO27).

    config SENSOR_ADC_UNIT
        int "Sensor ADC Unit"
        default 2
        range 1 2
        help
            The ADC unit number for the sensor. The ESP32 has two ADC units,
            ADC_UNIT_1 and ADC_UNIT_2. Default is ADC UNIT 2.

    config SENSOR_ADC_CHANNEL
        int "Sensor ADC Channel"
        default 7 if IDF_TARGET_ESP32S3
        default 9 if IDF_TARGET_ESP32
        help
            The ADC channel number for the sensor. Default is A0 on QtPy ESP32S3
            (ADC2_CH7) and QtPy ESP32 Pico (ADC2_CH9).

    config EXAMPLE_SSP_ENABLED
        bool "Secure Simple Pairing"
        depends on BT_CLASSIC_ENABLED
        default y
        help
            This enables the Secure Simple Pairing. If disable this option,
            Bluedroid will only support Legacy Pairing

    config EXAMPLE_HID_HOST_ENABLED
        bool "Enable Example HID Host"
        depends on BT_NIMBLE_ENABLED
        default y
        select BT_NIMBLE_HID_SERVICE
        help
            This enables Nimble HID Host

endmenu
```

## sdkconfig.defaults
```kconfig
# Partition Table
CONFIG_PARTITION_TABLE_CUSTOM=y
CONFIG_PARTITION_TABLE_CUSTOM_FILENAME="partitions.csv"

# bluetooth
CONFIG_BT_ENABLED=y
CONFIG_BTDM_CTRL_MODE_BTDM=y
CONFIG_BTDM_CTRL_HCI_MODE_VHCI=y
CONFIG_BTDM_CTRL_AUTO_LATENCY=y
CONFIG_BT_BLUEDROID_ENABLED=y
CONFIG_BT_CLASSIC_ENABLED=y
CONFIG_BT_BLE_ENABLED=y
CONFIG_BT_HID_ENABLED=y
CONFIG_BT_HID_HOST_ENABLED=y
CONFIG_BT_BLE_42_FEATURES_SUPPORTED=y
CONFIG_BT_GATTC_NOTIF_REG_MAX=16
CONFIG_PARTITION_TABLE_SINGLE_APP_LARGE=y

# freeRTOS
CONFIG_FREERTOS_HZ=1000

# ESP32-specific
#
CONFIG_ESP_DEFAULT_CPU_FREQ_MHZ_240=y
CONFIG_ESP_DEFAULT_CPU_FREQ_MHZ=240

# Common ESP-related
#
CONFIG_ESP_MAIN_TASK_STACK_SIZE=8192

CONFIG_COMPILER_CXX_EXCEPTIONS=y
```
